## arch/arm/mach-larm/Kconfig
```kconfig
if ARCH_LARM

config TARGET_LARM_ONE_BOARD
	bool "LARM one board"
	select CPU_V7A
	help
        LARM one board


source "board/larm/larm_one/Kconfig"

endif
```

## board/larm/larm_one/Kconfig
```kconfig
if TARGET_LARM_ONE_BOARD

config SYS_BOARD
	default "larm_one"

config SYS_VENDOR
	default "larm"

config SYS_CONFIG_NAME
	default "larm_one"

endif
```
